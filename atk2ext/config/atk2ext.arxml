AUTOSAR XML (schema 4-0-3)
package /Ecuc
  module config Os: ecuc-def-edition=4.2.0, implementation-config-variant=VARIANT-PRE-COMPILE
    Atk2ExtEvent (OsEvent)
    Atk2ExtCyclicTask (OsTask): OsTaskActivation=1, OsTaskPriority=15, OsTaskStackSize=592, OsTaskSchedule=FULL
    Atk2ExtCycArm (OsAlarm): OsAlarmCounterRef=MAIN_HW_COUNTER
      OsAlarmAction
        OsAlarmActivateTask: OsAlarmActivateTaskRef=Atk2ExtCyclicTask
      OsAlarmAutostart:
        OsAlarmAlarmTime = 10000
        OsAlarmCycleTime = 1000
        OsAlarmAutostartType = ABSOLUTE
        OsAlarmAppModeRef = AppMode{1..3}
