AUTOSAR XML (schema 4-0-3)
package /Ecuc
  module config Os: ecuc-def-edition=4.2.0, implementation-config-variant=VARIANT-PRE-COMPILE
    Atk2ExtTestTask (OsTask): OsTaskActivation=1, OsTaskPriority=12, OsTaskStackSize=592, OsTaskSchedule=FULL, OsTaskEventRef=Atk2ExtEvent
      OsTaskAutostart: OsTaskAppModeRef=AppMode1
    Atk2ExtTest2Task (OsTask): OsTaskActivation=1, OsTaskPriority=5, OsTaskStackSize=592, OsTaskSchedule=FULL, OsTaskEventRef=Atk2ExtEvent
