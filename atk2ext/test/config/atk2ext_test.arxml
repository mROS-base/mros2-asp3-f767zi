AUTOSAR XML (schema 4-0-3)
package /Ecuc
  module config Os: ecuc-def-edition=4.2.0, implementation-config-variant=VARIANT-PRE-COMPILE
    7 x OsTask, all with OsTaskActivation=1, OsTaskStackSize=512, OsTaskSchedule=FULL, OsTaskEventRef=Atk2ExtEvent:
      Atk2TaskTestControl: OsTaskPriority=4
        OsTaskAutostart: OsTaskAppModeRef=AppMode1
      Atk2TaskTestSupplier1: OsTaskPriority=4
      Atk2TaskTestSupplier2: OsTaskPriority=9
      Atk2TaskTestSupplier3: OsTaskPriority=11
      Atk2TaskTestConsumer1: OsTaskPriority=4
      Atk2TaskTestConsumer2: OsTaskPriority=9
      Atk2TaskTestConsumer3: OsTaskPriority=11
    Atk2TaskTestCyclicHandler (OsAlarm): OsAlarmCounterRef=MAIN_HW_COUNTER
      OsAlarmAction
        OsAlarmCallback: OsAlarmCallbackName=Atk2TestCyclicHandler
      OsAlarmAutostart: OsAlarmAlarmTime=10000, OsAlarmCycleTime=1000, OsAlarmAutostartType=ABSOLUTE, OsAlarmAppModeRef=AppMode1
